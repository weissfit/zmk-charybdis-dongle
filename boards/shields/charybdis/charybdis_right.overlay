#include "charybdis.dtsi"
#include "charybdis_3610.dtsi"
#include "split_input_common.dtsi"

&default_transform {
    col-offset = <6>;
};

&kscan0 {
    compatible = "zmk,kscan-gpio-matrix";

    col-gpios
        = <&gpio0 19 (GPIO_ACTIVE_HIGH | GPIO_PULL_DOWN)>
        , <&gpio0 20 (GPIO_ACTIVE_HIGH | GPIO_PULL_DOWN)>
        , <&gpio0 10 (GPIO_ACTIVE_HIGH | GPIO_PULL_DOWN)>
        , <&gpio0 6 (GPIO_ACTIVE_HIGH | GPIO_PULL_DOWN)>
        , <&gpio0 7 (GPIO_ACTIVE_HIGH | GPIO_PULL_DOWN)>
        , <&gpio0 8 (GPIO_ACTIVE_HIGH | GPIO_PULL_DOWN)>
        ;

    row-gpios
        = <&gpio0 21 GPIO_ACTIVE_HIGH>
        , <&gpio0 18 GPIO_ACTIVE_HIGH>
        , <&gpio0 5 GPIO_ACTIVE_HIGH>
        , <&gpio0 4 GPIO_ACTIVE_HIGH>
        , <&gpio0 9 GPIO_ACTIVE_HIGH>
        ;
};

&trackball_split {
    device = <&trackball>;
};
